## boards/shields/macropad33/Kconfig.defconfig
```kconfig
# Copyright (c) 2020 The ZMK Contributors
# SPDX-License-Identifier: MIT

if SHIELD_MACROPAD33

config ZMK_KEYBOARD_NAME
    default "Mcrpd33E"

endif
```

## boards/shields/reviung41/Kconfig.shield
```kconfig
# Copyright (c) 2020 The ZMK Contributors
# SPDX-License-Identifier: MIT

config SHIELD_MACROPAD33
    def_bool $(shields_list_contains,macropad33)
```

## config/boards/shields/macropad33/Kconfig.defconfig
```kconfig
# Copyright (c) 2020 The ZMK Contributors
# SPDX-License-Identifier: MIT

if SHIELD_MACROPAD33

config ZMK_KEYBOARD_NAME
    default "macropad33"

endif
```
